## arch/arm64/configs/physwizz_defconfig
```kconfig
# sdm450_sec_j8y18lte_cis_ser_defconfig

CONFIG_SEC_J8Y18LTE_PROJECT=y
CONFIG_MACH_J8Y18LTE_CIS_SER=y

#
# Display
#
CONFIG_PANEL_S6E8AA5X01_AMS561RA01_HD=y
CONFIG_PANEL_S6E8AA5X01_AMS604RM01_HD=y
CONFIG_FB_MSM_MDSS_SAMSUNG=y

# BATTERY configs
CONFIG_BATTERY_SAMSUNG=y
CONFIG_BATTERY_SAMSUNG_V2=y
CONFIG_BATTERY_NOTIFIER=y
CONFIG_SAMSUNG_LPM_MODE=y
CONFIG_BATTERY_SWELLING=y
CONFIG_CHARGER_SM5708=y
CONFIG_FUELGAUGE_SM5708=y
CONFIG_BATTERY_AGE_FORECAST=y
# CONFIG_UPDATE_BATTERY_DATA is not set
CONFIG_BATTERY_CISD=y
CONFIG_SEC_ABC=y
CONFIG_SEC_MPP_SHARE=y

#MUIC configs
CONFIG_MFD_CORE=y
CONFIG_USE_MUIC=y
#CONFIG_MUIC_SUPPORT_CCIC=y
CONFIG_MUIC_NOTIFIER=y
CONFIG_VBUS_NOTIFIER=y
CONFIG_VBUS_NOTIFIER_WORK=y
#CONFIG_MUIC_HV=y is not set
CONFIG_UART3=y
CONFIG_USB_OTG_WHITELIST_FOR_MDM=y

#USB
# CONFIG_DUAL_ROLE_USB_INTF is not set

# Audio
CONFIG_SAMSUNG_JACK=y
CONFIG_SND_SOC_TFA9896=y
CONFIG_SEC_SND_ADAPTATION=y
CONFIG_SEC_SND_TFA98XX=y

#MUIC-SM5708

CONFIG_MFD_SM5708=y
CONFIG_MUIC_UNIVERSAL=y
CONFIG_MUIC_UNIVERSAL_SM5708=y
#CONFIG_MUIC_UNIVERSAL_SM5705_AFC is not set
#CONFIG_MUIC_SM5705_SWITCH_CONTROL_GPIO is not set
CONFIG_MUIC_PINCTRL=y
CONFIG_MUIC_UNIVERSAL_MULTI_SUPPORT=y
CONFIG_MUIC_SUPPORT_RUSTPROOF=y

#
# TSP
#
CONFIG_TOUCHSCREEN_ZINITIX_ZT75XX_TCLM=y
CONFIG_TOUCHSCREEN_DUMP_MODE=y

# SD card
CONFIG_SEC_HYBRID_TRAY=y

#MOTOR
CONFIG_MSM_VIBRATOR=y

#GPIO EXPANDER
CONFIG_GPIO_PCAL6416A=y

#HALL
CONFIG_SENSORS_HALL=y

#Sensor
CONFIG_SENSORS_CORE=y
CONFIG_SENSORS_STK3013=y
CONFIG_SENSORS_LIS2DS=y
CONFIG_SENSORS_LIS2DS_I2C=y
CONFIG_SENSORS_A96T3X6=y

#Fingerprint sensor
CONFIG_SENSORS_FINGERPRINT=y
CONFIG_SENSORS_ET5XX=y
CONFIG_SENSORS_FP_SPI_NUMBER=4
CONFIG_SENSORS_FP_SPI_GPIO_START=12
CONFIG_SENSORS_FP_SPI_GPIO_END=15
CONFIG_SENSORS_FINGERPRINT_32BITS_PLATFORM_ONLY=y

#FLASH
CONFIG_LEDS_SM5708=y
CONFIG_DUAL_LEDS_FLASH=y
##CONFIG_REAR_DUAL_LED_FLASH=y
CONFIG_FRONT_LED_FLASH=y
##CONFIG_FRONT_DUAL_LED_FLASH=y
CONFIG_LEDS_SEPARATE_PREFLASH=y

#CAMERA
CONFIG_CAMERA_SYSFS_V2=y
CONFIG_GET_REAR_MODULE_ID=y
CONFIG_GET_FRONT_MODULE_ID=y
CONFIG_MSM_FRONT_EEPROM=y
CONFIG_SAMSUNG_MULTI_CAMERA=y
CONFIG_CAMERA_DUAL_REAR=y
CONFIG_S5K3P8=y
#CONFIG_CAMERA_DUAL_FRONT is not set

#EPDG
CONFIG_NET_CORE=y
CONFIG_NET_SCH_PRIO=y
CONFIG_NET_SCHED=y   #depends on CONFIG_NET  which is enabled by default.. coz not seeing in the config file
CONFIG_NET_CLS_BASIC=y # required if basic is being used as a filter. depends on CONFIG_NET_CLS so enabling it by default
CONFIG_NET_CLS=y
CONFIG_NET_CLS_ACT=y # for enabling the action target.
CONFIG_NET_ACT_MIRRED=y  # for enabling the mirred target for redirecting the packet between the devices.
CONFIG_NET_EMATCH=y   #basic uses extended matches so this has to be present
CONFIG_NET_SCH_INGRESS=y # classifier for ingress packet
#EPDG

# SSWAP
CONFIG_SWAP=y
CONFIG_FRONTSWAP=y
CONFIG_ZSMALLOC=y
CONFIG_ZSMALLOC_STAT=y
CONFIG_ZSMALLOC_OBJ_SEQ=n
CONFIG_PGTABLE_MAPPING=y
CONFIG_ZRAM=y
# CONFIG_ZSWAP is not set
# CONFIG_ZSWAP_COMPACTION is not set
# CONFIG_ZSWAP_ENABLE_WRITEBACK is not set
CONFIG_ZPOOL=y
CONFIG_DIRECT_RECLAIM_FILE_PAGES_ONLY=y
CONFIG_INCREASE_MAXIMUM_SWAPPINESS=y
CONFIG_FIX_INACTIVE_RATIO=y
CONFIG_TIGHT_PGDAT_BALANCE=y
# CONFIG_VNSWAP is not set
# CONFIG_SWAP_ENABLE_READAHEAD is not set

CONFIG_MMAP_READAROUND_LIMIT=8

# selinux

CONFIG_KPROBES=y
CONFIG_HAVE_KPROBES=y
CONFIG_KPROBE_EVENTS=y

CONFIG_EXT2_FS_XATTR=y
CONFIG_EXT2_FS_SECURITY=y
CONFIG_EXT4_FS_XATTR=y
CONFIG_EXT4_FS_SECURITY=y
CONFIG_AUDIT=y
CONFIG_AUDITSYSCALL=y
CONFIG_SECURITY=y
CONFIG_LSM_MMAP_MIN_ADDR=4096
CONFIG_SECURITY_NETWORK=y
CONFIG_SECURITY_SELINUX=y
CONFIG_SECURITY_SELINUX_DEVELOP=y
CONFIG_SECURITY_SELINUX_AVC_STATS=y
CONFIG_SECURITY_SELINUX_CHECKREQPROT_VALUE=y
CONFIG_NETWORK_SECMARK=y
CONFIG_NF_CONNTRACK_SECMARK=y
CONFIG_NETFILTER_XT_TARGET_CONNSECMARK=y
CONFIG_NETFILTER_ADVANCED=y
CONFIG_IP_NF_SECURITY=y
CONFIG_DEFAULT_SECURITY=y
CONFIG_DEFAULT_SECURITY="selinux"
CONFIG_SDCARD_FS_XATTR=y
CONFIG_ECRYPT_FS_VIRTUAL_FAT_XATTR=y
CONFIG_FAT_VIRTUAL_XATTR=y

# selinux log
CONFIG_PROC_AVC=y




# added by physwizz

CONFIG_LOCALVERSION="-physwizz"
# CONFIG_LOCALVERSION_AUTO is not set
CONFIG_CC_OPTIMIZE_FOR_PERFORMANCE=y
CONFIG_CPU_IDLE=y
CONFIG_CPU_FREQ=y
CONFIG_SCHED_FREQ_INPUT=y
CONFIG_CPU_FREQ_GOV_POWERSAVE=y
CONFIG_CPU_FREQ_GOV_USERSPACE=y
CONFIG_CPU_FREQ_GOV_ONDEMAND=y
CONFIG_CPU_FREQ_GOV_INTERACTIVE=y
CONFIG_CPU_FREQ_GOV_CONSERVATIVE=y
CONFIG_CPU_BOOST=y


################################
# Qualcomm WLAN Built-in driver
################################
CONFIG_PRONTO_WLAN=y
CONFIG_PRIMA_WLAN_BTAMP=n
CONFIG_PRIMA_WLAN_LFR=y
CONFIG_PRIMA_WLAN_11AC_HIGH_TP=y
CONFIG_QCOM_TDLS=y
CONFIG_QCOM_VOWIFI_11R=y
CONFIG_ENABLE_LINUX_REG=y
CONFIG_WLAN_OFFLOAD_PACKETS=y
CONFIG_QCOM_ESE=y
CONFIG_QCOM_ESE_UPLOAD=y
CONFIG_WLAN_FEATURE_11W=y
CONFIG_PRIMA_WLAN_OKC=y

# From 8953

CONFIG_CPU_FREQ_LIMIT=y

CONFIG_CPU_FREQ_LIMIT_HMP=n


# Sched booster with cpu min limit
CONFIG_CPU_FREQ_LIMIT_SCHEDBOOST=y
```
